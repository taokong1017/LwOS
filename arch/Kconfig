## arch/Kconfig
```kconfig
menu "Arch"

choice ARCH_TYPE
	prompt "Arch Option"
	default CONFIG_ARM
	help
		This Option will enable compiler Optimize options.

config CONFIG_ARM64
	bool "ARM64"

endchoice

if CONFIG_ARM64
	source "arch/arm64/Kconfig"
endif

endmenu
```

## arch/arm64/Kconfig
```kconfig
config CONFIG_FPU_ENABLE
	bool "Enable Floating Pointer Unit"
	default n
	help
		This option will enable the floating procedure in system.

choice
	prompt "Endiane Option"
	default CONFIG_LITTLE_ENDIANE
	help
		This Option will enable endiane options.

config CONFIG_LITTLE_ENDIANE
	bool "Litte Endiane"
endchoice

choice
	prompt "Page Size Option"
	default CONFIG_4K_PAGE_SIZE
	help
		This option is used in configuring the Memory Management Unit (MMU) page size.

config CONFIG_4K_PAGE_SIZE
	bool "4K Page Size"
endchoice

config CONFIG_CPUS_MAX_NUM
	int "CPUs Maximum Number"
	default 2
	range 1 4
	help
		This represents the number of phyiscal cores.

choice
	prompt "GIC Option"
	default CONFIG_GIC_V2
	help
		This Option will generate GIC options.

config CONFIG_GIC_V2
	bool "GIC V2"
endchoice
```

## components/Kconfig
```kconfig
menu "Components"

source "components/rpmsg/Kconfig"
source "components/shell/Kconfig"

endmenu
```

## components/rpmsg/Kconfig
```kconfig
menu "RPMSG"

config CONFIG_RPMSG
	bool "Kernel RPMSG"
	default n

choice
	prompt "RPMSG Use State"
	default CONFIG_RPMSG_KERNEL_USE
	depends on CONFIG_RPMSG
	help
		The rpmsg component provides a choice to use in kernel state or user state.

config CONFIG_RPMSG_KERNEL_USE
	bool "Enable RPMSG Kenerl Use"

config CONFIG_RPMSG_USER_USE
	bool "Enable RPMSG User Use"

endchoice

endmenu
```

## components/shell/Kconfig
```kconfig
menu "Shell"

config CONFIG_SHELL
	bool "Kernel Shell"
	default y
	help
		The shell is the common entry for user to interact with the kernel operation system.
		It is also a command line interface to obtain system status and request system services.

if CONFIG_SHELL

	config CONFIG_SHELL_CMD_BUFFER_SIZE
		int "Shell Command Buffer Size"
		default 128
		range 128 512
		help
			The shell is capable of receiving the maximum allowable characters for a command input.

	config CONFIG_SHELL_CMD_SPACE_SIZE
		int "Shell Command Space Size"
		default 1
		range 1 512
		help
			For shell safety, a space should be set between different shell command sections to
			isolate them. Here, each "1" represents 8 bytes.

	config CONFIG_SHELL_TERMINAL_WIDTH_SIZE
		int "Shell Terminal Width Size"
		default 80
		help
			The shell terminal initial width size.

	config CONFIG_SHELL_TERMINAL_HEIGHT_SIZE
		int "Shell Terminal Height Size"
		default 25
		help
			The shell terminal height initial size.
	
	config CONFIG_SHELL_ARGC_MAX
		int "Maximum Arguments Number"
		range 3 32
		default 10
		help
			Maximum number of arguments that can build a command.

	config CONFIG_SHELL_HEXDUMP_BYTES_PER_LINE
		int "Hexdump Bytes Per Line"
		default 16
		range 1 64
		help
			The number of bytes per line in hexdump.

	config CONFIG_SHELL_TX_RING_BUFFER_SIZE
		int "Shell Tx Ring Buffer Size"
		default 128
		range 128 1024
		help
			The size of the shell tx ring buffer.

	config CONFIG_SHELL_RX_RING_BUFFER_SIZE
		int "Shell Rx Ring Buffer Size"
		default 128
		range 128 1024
		help
			The size of the shell rx ring buffer.

	config CONFIG_SHELL_UART_TIMER_INTERVAL
		int "Shell Uart Timer Interval"
		default 10
		range 1 1000
		help
			The shell uart timer interval(ms) for uart polling data.

	config CONFIG_SHELL_HISTORY_BUFFER_SIZE
		int "Shell History Buffer Size"
		default 128
		range 64 1024
		help
			The shell history buffer size.

	config CONFIG_SHELL_PRINTF_BUFF_SIZE
		int "Shell Printf Buff Size"
		default 512
		range 64 1024
		help
			The shell printf buff size.

choice
	prompt "Shell Uart Synchronous Option"
	default CONFIG_SHELL_UART_IRQ_TYPE
	help
		This Option will choose Synchronous type.

config CONFIG_SHELL_UART_POLL_TYPE
		bool "Uart Poll Type"
config CONFIG_SHELL_UART_IRQ_TYPE
		bool "Uart IRQ Type"
endchoice

endif

endmenu
```

## config/aarch64_defconfig
```kconfig
CONFIG_COMPILER_OPTIMIZE_SPEED=y
CONFIG_ARM64=y
CONFIG_FPU_ENABLE=y
CONFIG_LITTLE_ENDIANE=y
CONFIG_4K_PAGE_SIZE=y
CONFIG_CPUS_MAX_NUM=2
CONFIG_GIC_V2=y
CONFIG_SMP=y
CONFIG_TICKS_PER_SECOND=1000
CONFIG_MSGQ_MAX_NUM=10
CONFIG_MSGQ_MAX_SIZE=128
CONFIG_KERNEL_STACK_SIZE=8192
CONFIG_INTERRUPT_STACK_SIZE=8192
CONFIG_TASK_002=y
```

## config/arm64_qemu_defconfig
```kconfig
CONFIG_COMPILER_OPTIMIZE_SPEED=y
CONFIG_ARM64=y
CONFIG_FPU_ENABLE=y
CONFIG_LITTLE_ENDIANE=y
CONFIG_4K_PAGE_SIZE=y
CONFIG_CPUS_MAX_NUM=2
CONFIG_GIC_V2=y
CONFIG_SMP=y
CONFIG_PAGE_TABLE_MAX_NUM=16
CONFIG_MEM_PARTITION_MAX_NUM=32
CONFIG_TICKS_PER_SECOND=4000
CONFIG_KERNEL_STACK_SIZE=8192
CONFIG_INTERRUPT_STACK_SIZE=8192
CONFIG_MSGQ_MAX_NUM=10
CONFIG_MSGQ_MAX_SIZE=128
CONFIG_KERNEL_HEAP_SIZE=1048576
CONFIG_USER_SPACE=y
CONFIG_USER_HEAP_SIZE=1048576
CONFIG_LIBC_STRING=y
CONFIG_LIBC_STD=y
CONFIG_LIBC_SCHED=y
CONFIG_LIBC_THREAD=y
CONFIG_LIBC_SEM_VALUE_MAX=32
CONFIG_RPMSG=y
CONFIG_RPMSG_KERNEL_USE=y
CONFIG_SHELL=y
CONFIG_SHELL_CMD_BUFFER_SIZE=128
CONFIG_SHELL_CMD_SPACE_SIZE=128
CONFIG_SHELL_TERMINAL_WIDTH_SIZE=100
CONFIG_SHELL_TERMINAL_HEIGHT_SIZE=25
CONFIG_SHELL_ARGC_MAX=10
CONFIG_SHELL_HEXDUMP_BYTES_PER_LINE=16
CONFIG_SHELL_TX_RING_BUFFER_SIZE=128
CONFIG_SHELL_RX_RING_BUFFER_SIZE=128
CONFIG_SHELL_UART_TIMER_INTERVAL=10
CONFIG_SHELL_HISTORY_BUFFER_SIZE=1024
CONFIG_SHELL_PRINTF_BUFF_SIZE=125
CONFIG_SHELL_UART_POLL_TYPE=y
CONFIG_SAMPLE_USER_TASK=y
```

## config/config.in
```kconfig
#
# For a description of the syntax of this configuration file,
# see Kconfig-language.txt
#
mainmenu "LwOS Configuration"

menu "Compiler"

choice
    prompt "Optimize Option"
    default CONFIG_COMPILER_OPTIMIZE_SPEED
    help
      This Option will enable compiler Optimize options.

config CONFIG_COMPILER_OPTIMIZE_NONE
    bool "Optimize None"
config CONFIG_COMPILER_OPTIMIZE_SPEED
    bool "Optimize Speed"
config CONFIG_COMPILER_OPTIMIZE_SIZE
    bool "Optimize Size"
endchoice

endmenu
```

## kernel/Kconfig
```kconfig
menu "Kernel"

config CONFIG_SMP
	bool "Enable SMP"
	default y
	help
		this option enables smp to use multiple CPUs.

config CONFIG_SPIN_LOCK_TRACE
	bool "Enable Spin Lock Trace"
	default n
	help
		This option enables to trace the spin lock. It is useful when debugging dead spin lock.

config CONFIG_PAGE_TABLE_MAX_NUM
	int "Page Table Maximum Number"
	default 16 if CONFIG_USER_SPACE
	default 1
	range 16 32 if CONFIG_USER_SPACE
	range 1 1 if !CONFIG_USER_SPACE

config CONFIG_MEM_PARTITION_MAX_NUM
	int "Memory Partition Maximum Number"
	default 32
	range 1 64
	help
		This represents the memory partition number.

config CONFIG_TICKS_PER_SECOND
	int "Tick Value Per Second"
	default 1000
	range 1 10000
	help
		This represents the tick value per second.

config CONFIG_KERNEL_STACK_SIZE
	int "Kernel Stack Size"
	default 8192
	range 4096 8192
	help
		This represents the kernel stack size for primary core initialization.

config CONFIG_INTERRUPT_STACK_SIZE
	int "Interrupt Stack Size"
	default 8192
	range 4096 8192
	help
		This represents the interrupt stack size for every cpu.

menu "Message Queue"

config CONFIG_MSGQ_MAX_NUM
	int "Maximum Message Queue Number"
	default 10
	range 1 1024
	help
	  This represents the maximum message number.

config CONFIG_MSGQ_MAX_SIZE
	int "Maximum Message Size"
	default 128
	range 1 1024
	help
	  This represents the maximum message size.

endmenu

config CONFIG_KERNEL_HEAP_SIZE
	int "Kernel Heap Size"
	default 1048576
	range 1048576 8388608
	help
		This represents the size of the kernel heap, which is used for dynamic memory
		allocation within the kernel.

config CONFIG_USER_SPACE
	bool "Enable User Space"
	default n
	help
		This option enables to use user space running applications.

if CONFIG_USER_SPACE

config CONFIG_USER_HEAP_SIZE
	int "User Heap Size"
	default 1048576
	range 1048576 8388608
	help
		This represents the size of the user heap, which is used for dynamic memory
		allocation within the user.

endif

endmenu
```

## lib/libc/Kconfig
```kconfig
menu "C Standard Library"

choice
	prompt "Library String Option"
	default CONFIG_LIBC_STRING
	help
		The C Standard Library provides a complete string interface including
		string manipulation, comparison, and memory operations. When enabled,
		applications can use standard string functions like strcpy, strcmp, and
		memcpy. The default 'y' setting is recommended for most systems as string
		operations are fundamental to most applications.

config CONFIG_LIBC_STRING
	bool "Enable Library String"
endchoice

config CONFIG_LIBC_STD
	bool "Enable Library STD"
	default y
	help
		The C Standard Library provides standard interface including
		file I/O, memory management, and basic utility functions. When enabled,
		applications can use standard C library functions. The default 'y' setting
		is recommended for most systems as it provides essential functionality.

config CONFIG_LIBC_CRYPT
	bool "Enable Library Crypt"
	default n
	help
		It is primarily used for password hashing, which is a
		fundamental security mechanism in the system. When enabled,
		applications can use cryptographic functions for secure password
		storage and verification. The default 'n' setting is recommended
		for systems without security requirements to reduce library footprint.

config CONFIG_LIBC_SCHED
	bool "Enable Library Sched"
	default y
	help
		The C Standard Library provides a complete scheduling interface including
		thread creation, priority management, and scheduling policies. When enabled,
		applications can use POSIX-compliant scheduling APIs. The default 'y' setting
		is recommended for systems requiring real-time task scheduling. Disable this
		only if your application does not require advanced scheduling features.

config CONFIG_LIBC_THREAD
	bool "Enable Library Thread"
	default y
	depends on CONFIG_USER_SPACE
	help
		The C Standard Library provides a complete thread interface including
		thread creation, synchronization primitives. When enabled, applications
		can use POSIX-compliant threading APIs. The default 'y' setting is 
		recommended for systems requiring multithreading support.

config CONFIG_LIBC_SEM_VALUE_MAX
	int "Maximum Semaphore Value"
	default 32
	range 1 64
	depends on CONFIG_LIBC_THREAD
	help
		Maximum value that a semaphore can hold in the system. This value
		determines the upper limit for semaphore counts during operations
		like sem_post(). The default value of 32 is suitable for most
		embedded systems.

endmenu
```

## samples/Kconfig
```kconfig
menu "Applications"

if CONFIG_USER_SPACE
source "samples/user/Kconfig"
endif

if !CONFIG_USER_SPACE
source "samples/kernel/Kconfig"
endif

endmenu
```

## samples/kernel/Kconfig
```kconfig
menu "Kernel Applications"

choice
	bool "Select Kernel Application"
	default CONFIG_SAMPLE_TASK_DELAY

config CONFIG_SAMPLE_TASK_DELAY
	bool "Kernel Task Delay Sample"
	help
		This configuration enables a simple task delay example implementation
		that demonstrates how to delay a task for a specified number of ticks.

config CONFIG_SAMPLE_TASK_STOP
	bool "Kernel Task Stop Sample"
	help
		This configuration enables a simple task stopping example implementation
		that demonstrates how to gracefully stop a task.

config CONFIG_SAMPLE_TASK_SUSPEND
	bool "Kernel Task Suspend Sample"
	help
		This configuration enables a simple task suspending example implementation
		that demonstrates how to suspend a task.

config CONFIG_SAMPLE_TASK_AFFINITY
	bool "Kernel Task Affinity Sample"
	help
		This configuration enables a simple task affinity example implementation
		that demonstrates how to set the task affinity.

config CONFIG_SAMPLE_TIMER
	bool "Kernel Timer Sample"
	help
		This configuration enables a simple timer example that demonstrates how 
		to use a timer within the kernel.

config CONFIG_SAMPLE_MSGQ
	bool "Kernel Messge Queue Sample"
	help
		This configuration enables a simple message queue example that demonstrates
		how to use a message queue within the kernel.

config CONFIG_SAMPLE_MUTEX
	bool "Kernel Mutex Sample"
	help
		This configuration enables a simple mutex example that demonstrates how to 
		use a mutex within the kernel.

config CONFIG_SAMPLE_SEM
	bool "Kernel Semphore Sample"
	help
		This configuration enables a simple semaphore example that demonstrates how
		to use a semaphore within the kernel.

config CONFIG_SAMPLE_RPMSG
	bool "Kernel Remote Rrocessor Message Sample"
	depends on CONFIG_RPMSG
	help
		This configuration enables a simple remote process message example that 
		demonstrates how to use a remote process message within the kernel.

endchoice

endmenu
```

## samples/user/Kconfig
```kconfig
menu "User Applications"

choice
	bool "Select User Application"
	default CONFIG_SAMPLE_USER_TASK

config CONFIG_SAMPLE_USER_TASK
	bool "Sample User Task"
	help
		This configuration enables a simple user task example that demonstrates
		how to use the task interface.

config CONFIG_SAMPLE_USER_MSGQ
	bool "Sample User Message Queue"
	help
		This configuration enables a simple user message queue example that demonstrates
		how to use the message queue interface.

config CONFIG_SAMPLE_USER_MUTEX
	bool "Sample User MUTEX"
	help
		This configuration enables a simple user mutex example that demonstrates
		how to use the mutex interface.

config CONFIG_SAMPLE_USER_SEM
	bool "Sample User Semphore"
	help
		This configuration enables a simple user semaphore example that demonstrates
		how to use the semaphore interface.

endchoice

endmenu
```
